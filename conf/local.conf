## conf/local.conf
```bitbake
# this is a sample of what might go in local.conf

# required for Freescale stuff to build
ACCEPT_FSL_EULA = "1"

# required for Qualcomm stuff to build
ACCEPT_EULA = "1"

# required to build netperf
LICENSE_FLAGS_WHITELIST_append = " non-commercial_netperf "

PREFERRED_VERSION_nodejs = "8.12.0"

IMAGE_INSTALL_append = " nodejs nano ncdu nmon psplash nodejs-npm packagegroup-core-buildessential cmake pkgconfig bison flex gstreamer1.0-dev gstreamer1.0-omx gstreamer1.0-omx-dev gstreamer1.0-plugins-good-dev gstreamer1.0-plugins-bad-dev gstreamer1.0-plugins-ugly-dev glibc-dev gdb ffmpeg ffmpeg-dev git dbus openssl omxplayer userland openssh-sftp-server wget valgrind"

DISTRO_FEATURES_remove = "x11 wayland"

WPE_PLATFORM = "egl touch"
WPE_BACKEND = "rpi libinput"
NETFLIX_BACKEND = "rpi"

#to remove virtualinput from PACKAGECONFIG
PACKAGECONFIG_pn-wpebackend-rdk = "${WPE_BACKEND}"

INHERIT += "extrausers"
EXTRA_USERS_PARAMS = "useradd -P raspberry root;"
EXTRA_IMAGE_FEATURES += "ssh-server-openssh"

WEBKITBROWSER_STARTURL = "http://192.168.1.171:8130/"
LICENSE_FLAGS_WHITELIST="commercial"
IMAGE_ROOTFS_EXTRA_SPACE = "2097152"
```
